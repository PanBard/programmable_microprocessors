#ifndef ESP32
#error This code is designed to run on ESP32 platform, not Arduino nor ESP8266! Please check your Tools->Board setting.
#endif
#include <SPI.h>
#include <LoRa.h>
#include <Adafruit_GFX.h>
#include <Adafruit_SSD1306.h>

//PINOUT -------------------------------------start
#include <Wire.h>  //for custom sda, scl define
//---lora
#define ss 12  //MOSI: 11, MISO: 9, SCK: 7
#define rst 16
#define dio0 2
//---lora
#define I2C_SDA 1  // oled sda
#define I2C_SCL 2  // oled scl

//PINOUT --------------------------------------end


// OLED setup ---------------------
Adafruit_SSD1306 display(128, 64, &Wire, -1);  // On ESP32 s2 mini:   pin11=(SDA),  pin12=(SCL); VCC=3.3v; Reset pin # (or -1 if sharing Arduino reset pin)
// OLED setup ---------------------


String inString = "";  // string to hold input

//joystick
int x_axis = 0;
int y_axis = 0;
//joystick

void setup() {

  // OLED setup ---------------------
  Wire.begin(I2C_SDA, I2C_SCL);                      //Wire.begin(I2C_SDA, I2C_SCL);
  if (!display.begin(SSD1306_SWITCHCAPVCC, 0x3C)) {  //See datasheet for Address; 0x3D for 128x64, 0x3C for 128x32
    Serial.println(F("SSD1306 allocation failed"));
    for (;;)
      ;  // Don't proceed, loop forever
  }
  display.clearDisplay();
  // OLED setup ---------------------
  

  pinMode(LED_BUILTIN, OUTPUT);
  Serial.begin(9600);

  LoRa.setPins(ss, rst, dio0);

  if (!LoRa.begin(433E6)) {
    Serial.println("Starting LoRa failed!");
    while (1) {
      Serial.print("MOSI: ");
      Serial.println(MOSI);
      Serial.print("MISO: ");
      Serial.println(MISO);
      Serial.print("SCK: ");
      Serial.println(SCK);
      Serial.print("SS: ");
      Serial.println(SS);

      digitalWrite(LED_BUILTIN, HIGH);  // turn the LED on (HIGH is the voltage level)
      delay(1000);                      // wait for a second
      digitalWrite(LED_BUILTIN, LOW);   // turn the LED off by making the voltage LOW
      delay(10000);
    };
  }
  delay(3000);
  Serial.println("LoRa receiver XD");
  displayTransformersLogo();
  display_content2("dziala", 1);
}

void loop() {
  loraEngineReceiver();

  // delay(100);
}

void loraEngineReceiver() {
  int packetSize = LoRa.parsePacket();

  if (packetSize) {

    digitalWrite(LED_BUILTIN, HIGH);  // turn the LED on (HIGH is the voltage level)
    delay(2);                         // wait for a second
    digitalWrite(LED_BUILTIN, LOW);   // turn the LED off by making the voltage LOW

    // read packet
    while (LoRa.available()) {
      int inChar = LoRa.read();
      inString += (char)inChar;
      // val = inString.toInt();
    }
    // print RSSI of packet
    Serial.print("' with RSSI ");
    Serial.println(LoRa.packetRssi());
    Serial.println(inString);
    display_content2(inString,LoRa.packetRssi() );
   
    inString = "";
    LoRa.packetRssi();
  }
}
void display_content2(String s, int n) {
  display.clearDisplay();                           // Clear display buffer
  display.drawLine(0, 32, 128, 32, SSD1306_WHITE);  // line (x1,y1,x2,y2,color)
  display.setTextSize(1);                           // Draw 2X-scale text
  display.setTextColor(SSD1306_WHITE);
  display.clearDisplay();  // Clear display buffer

  display.setCursor(1, 5);
  display.println(F("rec:"));
  display.setCursor(25, 5);
  display.println(s);

  display.setCursor(1, 30);
  display.println(F("RSSI:"));
  display.setCursor(30, 30);
  display.println(n);
  display.display();  // Update screen
  display.display();  // Update screen
}


const unsigned char Autobot_logo[] PROGMEM = {
  0x00, 0x00, 0x00, 0x00, 0x00, 0x00, 0x03, 0xff, 0xc0, 0x00, 0x00, 0x00, 0x00, 0x00, 0x00, 0x00,
  0x00, 0x00, 0x00, 0x00, 0x00, 0x7f, 0xff, 0xff, 0x00, 0x00, 0x00, 0x00, 0x00, 0x00, 0x00, 0x00,
  0x00, 0x00, 0x00, 0x03, 0xff, 0xff, 0xff, 0xe0, 0x00, 0x00, 0x00, 0x00, 0x00, 0x00, 0x00, 0x00,
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  0x00, 0x00, 0x00, 0x00
};
void displayTransformersLogo() {
  display.clearDisplay();
  display.drawBitmap(0, 0, Autobot_logo, 120, 60, 1);  //(x,y,bitmap_name,width,height,1)
  display.display();
  delay(1000);
};