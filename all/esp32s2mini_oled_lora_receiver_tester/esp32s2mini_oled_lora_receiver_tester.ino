#ifndef ESP32
#error This code is designed to run on ESP32 platform (ESP32 S2 mini [LOLIN S2 Mini]), not Arduino nor ESP8266! Please check your Tools->Board setting.
#endif
#include <SPI.h>
#include <LoRa.h> // by Sandeep Mistry
#include <Adafruit_GFX.h>
#include <Adafruit_SSD1306.h> // by Adafruit
#include <Wire.h>  //for custom sda, scl define

//---lora
#define ss 12  //MOSI: 11, MISO: 9, SCK: 7
#define rst 16
#define dio0 2
//---lora

//--- oled
#define I2C_SDA 1  // sda
#define I2C_SCL 2  // scl
//--- oled

// OLED setup ---------------------
Adafruit_SSD1306 display(128, 64, &Wire, -1);  // On ESP32 s2 mini:   pin1=(SDA),  pin2=(SCL); VCC=3.3v; Reset pin # (or -1 if sharing Arduino reset pin)
// OLED setup ---------------------

String inString = "";  // string to hold input from lora
int counter = 0; //count received lora packets 
long intervalTime = 0; //for time measurement between received lora packet

void setup() {
  Serial.begin(9600);
  pinMode(LED_BUILTIN, OUTPUT);
  oled_start(); //OLED setup 
  lora_start(); //LORA setup
  oled_display("Status: ok");
}

void loop() {
  loraEngineReceiver();
}

void loraEngineReceiver() {
  int packetSize = LoRa.parsePacket();

  if (packetSize) {

    digitalWrite(LED_BUILTIN, HIGH);  // turn the LED on (HIGH is the voltage level)
    delay(2);                         // wait for a second
    digitalWrite(LED_BUILTIN, LOW);   // turn the LED off by making the voltage LOW

    // read packet
    while (LoRa.available()) { //loop for lora message
      int inChar = LoRa.read();
      inString += (char)inChar;
    }
    Serial.print(" Packet: ");
    Serial.println(inString);
    Serial.print("' with RSSI ");
    Serial.println(LoRa.packetRssi());
    oled_display_lora_content(inString, LoRa.packetRssi() );
    inString = ""; // clear received message
    counter++;
    intervalTime = millis();
  }
}
void oled_display_lora_content(String message, int rssi) {
  display.clearDisplay();                           // Clear display buffer
  display.setTextSize(1);                           // Draw 2X-scale text
  display.setTextColor(SSD1306_WHITE);

  display.setCursor(1, 5);
  display.println(F("rec:"));
  display.setCursor(25, 5);
  display.println(message);

  display.setCursor(1, 30);
  display.println(F("RSSI:"));
  display.setCursor(30, 30);
  display.println(rssi);

  display.setCursor(1, 40);
  display.println(F("inter. time: "));
  display.setCursor(80, 40);
  display.println(String((millis() - intervalTime)/1000)+"s");

  display.setCursor(1, 50);
  display.println(F("nr: "));
  display.setCursor(20, 50);
  display.println(counter);

  display.display();  // Update screen
}

void oled_display(String message) {
  display.clearDisplay();                           // Clear display buffer
  display.setTextSize(1);                           // Draw 2X-scale text
  display.setTextColor(SSD1306_WHITE);
  display.setCursor(1, 35);
  display.println(message);
  display.display();  // Update screen
}


const unsigned char Autobot_logo[] PROGMEM = {
  0x00, 0x00, 0x00, 0x00, 0x00, 0x00, 0x03, 0xff, 0xc0, 0x00, 0x00, 0x00, 0x00, 0x00, 0x00, 0x00,
  0x00, 0x00, 0x00, 0x00, 0x00, 0x7f, 0xff, 0xff, 0x00, 0x00, 0x00, 0x00, 0x00, 0x00, 0x00, 0x00,
  0x00, 0x00, 0x00, 0x03, 0xff, 0xff, 0xff, 0xe0, 0x00, 0x00, 0x00, 0x00, 0x00, 0x00, 0x00, 0x00,
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  0x00, 0x00, 0x00, 0x00
};
void displayTransformersLogo() {
  display.clearDisplay();
  display.drawBitmap(0, 0, Autobot_logo, 120, 60, 1);  //(x,y,bitmap_name,width,height,1)
  display.display();
  delay(1000);
};

void oled_start() {
  Wire.begin(I2C_SDA, I2C_SCL);                      //Wire.begin(I2C_SDA, I2C_SCL);
  if (!display.begin(SSD1306_SWITCHCAPVCC, 0x3C)) {  //See datasheet for Address; 0x3D for 128x64, 0x3C for 128x32
    Serial.println(F("SSD1306 allocation failed"));
    for (;;);  // Don't proceed, loop forever
  }
  Serial.println("oled display status: ok");
  display.clearDisplay();
  displayTransformersLogo();
}

void lora_start() {
  LoRa.setPins(ss, rst, dio0);
   if (!LoRa.begin(433E6)) {
    while (1) {
      oled_display("Starting LoRa failed!");
      Serial.println("Starting LoRa failed!");
      Serial.print("MOSI: ");
      Serial.println(MOSI);
      Serial.print("MISO: ");
      Serial.println(MISO);
      Serial.print("SCK: ");
      Serial.println(SCK);
      Serial.print("SS: ");
      Serial.println(SS);
      digitalWrite(LED_BUILTIN, HIGH);  // turn the LED on (HIGH is the voltage level)
      delay(1000);                      // wait for a second
      digitalWrite(LED_BUILTIN, LOW);   // turn the LED off by making the voltage LOW
      delay(10000);
    };
  }
  Serial.println("LoRa status: ok");
}